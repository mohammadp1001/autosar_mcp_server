AUTOSAR XML (schema 00050)
package /MyPackages
  app type MyInt: category=VALUE
