AUTOSAR XML (schema 00050)
package /NewPackage
  sender receiver interface MyInterface
  application sw component type MyComponent
    provide port MyPort: provided-interface=MyInterface
