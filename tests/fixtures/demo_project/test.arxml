AUTOSAR XML (schema 00048)
package /MyPackages
  app type MyInt: category=VALUE
